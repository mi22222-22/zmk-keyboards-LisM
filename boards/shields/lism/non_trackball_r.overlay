#include "non_trackball.overlay"
#include <dt-bindings/zmk/input_transform.h>

// 左（split経由）のリスナーを有効化
&left_listener {
    status = "okay";
    device = <&left_split>;  // 左トラックボールを参照

    scroller {
        layers = <2>;
        input-processors = 
            <&zip_xy_to_scroll_mapper>,
            <&zip_scroll_transform INPUT_TRANSFORM_ROTATE_180>,
            <&zip_scroll_scaler 1 16>;
    };
};