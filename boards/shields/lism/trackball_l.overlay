#include <dt-bindings/zmk/input_transform.h>
#include "lism.dtsi"

&spi0 {
    status = "okay";

    tb_left: trackball@0 {
        status = "okay";
        compatible = "pixart,paw3222";
        reg = <0>;
        spi-max-frequency = <2000000>;
        irq-gpios = <&xiao_d 6 (GPIO_ACTIVE_LOW | GPIO_PULL_UP)>;
    };
};

// Overrides for the input-split child node
&left_split {
    device = <&tb_left>;

    // レイヤー0の通常モード（XY反転のみ）
    input-processors = <&zip_xy_transform 3>; // 3 = X_INVERT | Y_INVERT

    // レイヤー2でスクロールモードに切り替える
    scroll_layer: scroll_layer {
        compatible = "zmk,input-transform";
        layers = <2>;
        input-processors = <
            &zip_xy_to_scroll_mapper,  // スクロールに変換
            &zip_xy_transform 3,       // XY反転
            &zip_scroll_scaler 1 16    // スクロール速度調整
        >;
    };

    // レイヤーごとの input-transform を input-processors に登録
    input-processors += <&scroll_layer>;
};


